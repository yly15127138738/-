/*********************************************************************************************
* 文件：main.c
* 作者：Lixm 2017.09.25
* 说明：温湿度传感器实验 例程  
*       获取温湿度传感器寄存器数据，打印到PC上
* 修改：
* 注释：
*********************************************************************************************/

/*********************************************************************************************
* 头文件
*********************************************************************************************/
#include <ioCC2530.h>
#include "clock.h"
#include "delay.h"
#include "htu21d.h"
#include "led.h"
#include "uart1.h"
#include "stdio.h"
#include "string.h"
#include "led.h"
/*********************************************************************************************
* 名称：main()
* 功能：逻辑代码
* 参数：无
* 返回：无
* 修改：
* 注释：
*********************************************************************************************/
void main(void)
{
  unsigned char flag = 0;
  float data = 0;                                               //存储寄存器数据变量
  char tx_buff[64];                                             //串口发送缓冲数组
  
  xtal_init();  //系统时钟初始化   
   led_init();  
  htu21d_init();                                                //温湿度传感器初始化
  uart1_init(0x00,0x00);                                        //串口初始化
  
  while(1)
  {
    if(flag == 0)
    {
      data = htu21d_get_data(TEMPERATURE)/100.0;                //读取传感器值
      sprintf(tx_buff,"温度:%.2f℃\r\n",data);                     //字符串复制
     if(data>33)
    {
     D2 = ON;
    }
    else
    {
     D2 = OFF;
    }
    }
    else
    {
      data = htu21d_get_data(HUMIDITY)/100.0;                   //读取传感器值
      sprintf(tx_buff,"湿度:%.2f％\r\n",data);                     //字符串复制
    }
    flag = !flag;
    uart1_send_string(tx_buff);                                 //串口打印

   // led_on(D2);
    memset(tx_buff,0,64);                                       //清空缓存
    delay_s(1);                                                 //延时1s
  }
}
